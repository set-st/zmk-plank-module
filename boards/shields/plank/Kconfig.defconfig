## boards/shields/plank/Kconfig.defconfig
```kconfig
if SHIELD_MY_BOARD

config ZMK_KEYBOARD_NAME
    default "Plank Keyboard"

endif

if ZMK_DISPLAY

config I2C
    default y

config SSD1306
    default y

config SSD1306_REVERSE_MODE
  default y

endif # ZMK_DISPLAY

if LVGL

config LVGL_HOR_RES_MAX
  default 128

config LVGL_VER_RES_MAX
  default 64

config LVGL_DPI
  default 148

config LV_Z_VDB_SIZE
    default 64

config LV_DPI_DEF
    default 148

config LV_Z_BITS_PER_PIXEL
    default 1

choice LV_COLOR_DEPTH
    default LV_COLOR_DEPTH_1
endchoice

endif # LVGL
```
